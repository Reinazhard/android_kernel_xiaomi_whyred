/* Copyright (c) 2017, The Linux Foundation. All rights reserved.
 * Copyright (C) 2019 XiaoMi, Inc.
 *
 * This program is free software; you can redistribute it and/or modify
 * it under the terms of the GNU General Public License version 2 and
 * only version 2 as published by the Free Software Foundation.
 *
 * This program is distributed in the hope that it will be useful,
 * but WITHOUT ANY WARRANTY; without even the implied warranty of
 * MERCHANTABILITY or FITNESS FOR A PARTICULAR PURPOSE.  See the
 * GNU General Public License for more details.
*/

/* sdm660-mtp.dtsi tulip specific diff */
&mtp_batterydata {
	#include "fg-gen3-batterydata-l6660cos-4000mah.dtsi"
	#include "fg-gen3-batterydata-l6660desay-4000mah.dtsi"
	#include "fg-gen3-batterydata-l6660atl-4000mah.dtsi"
};

&pm660_charger {
	qcom,fv-max-uv  = <4408000>;
	qcom,thermal-mitigation
			= <2500000 2300000 2200000 2000000 1500000 1000000 800000 400000 100000>;
	qcom,thermal-mitigation-china
			= <2500000 2300000 2200000 2000000 1500000 1000000 800000 400000 100000>;
};

&pm660_fg {
	qcom,fg-recharge-soc-thr = <99>;
	qcom,fg-auto-recharge-soc;
};

#include "../common/bouquet.dtsi"
#include "tulip-camera.dtsi"
#include "tulip-touch.dtsi"
