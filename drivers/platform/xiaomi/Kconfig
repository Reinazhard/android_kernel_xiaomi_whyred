## drivers/platform/xiaomi/Kconfig
```kconfig
config XIAOMI_WHYRED
	default n
	bool "Custom for hardware E7S_pcb"
	help
	  Custom for E7S_pcb.

config XIAOMI_TULIP
	default n
	bool "Custom for hardware E7T_pcb"
	help
	  Custom for E7T_pcb

config XIAOMI_NEW_CAMERA
	default n
	bool "Xiaomi new camera blobs"
	help
	  Support for new camera blobs
```

## drivers/staging/android/Kconfig
```kconfig
menu "Android"

if ANDROID

config ASHMEM
	bool "Enable the Anonymous Shared Memory Subsystem"
	default n
	depends on SHMEM
	help
	  The ashmem subsystem is a new shared memory allocator, similar to
	  POSIX SHM but with different behavior and sporting a simpler
	  file-based API.

	  It is, in theory, a good memory allocator for low-memory devices,
	  because it can discard shared memory units when under memory pressure.

config ANDROID_VSOC
	tristate "Android Virtual SoC support"
	default n
	depends on PCI_MSI
	help
	  This option adds support for the Virtual SoC driver needed to boot
	  a 'cuttlefish' Android image inside QEmu. The driver interacts with
	  a QEmu ivshmem device. If built as a module, it will be called vsoc.

source "drivers/staging/android/ion/Kconfig"

config ALLOC_BUFFERS_IN_4K_CHUNKS
	bool "Turns off allocation optimization and allocate only 4K pages"
	depends on ARCH_QCOM && ION
	help
          Choose this option if you want ION to allocate buffers in
          only 4KB chunks.

endif # if ANDROID

endmenu
```
